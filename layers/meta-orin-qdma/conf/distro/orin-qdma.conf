## layers/meta-orin-qdma/conf/distro/orin-qdma.conf
```bitbake
DISTRO = "orin-qdma"
DISTRO_NAME = "Orin NX QDMA host development"
DISTRO_VERSION = "6.0.3-r39.2.1"
DISTRO_CODENAME = "wrynose"
DISTRO_FEATURES = "acl ipv4 ipv6 pci pam seccomp systemd usrmerge"
INIT_MANAGER = "systemd"
PACKAGE_CLASSES = "package_ipk"
PREFERRED_PROVIDER_virtual/kernel:tegra = "linux-noble-nvidia-tegra"
LICENSE_FLAGS_ACCEPTED = ""
SANITY_TESTED_DISTROS = "ubuntu-24.04"
```

## meta-orin-qdma/conf/layer.conf
```bitbake
BBPATH .= ":${LAYERDIR}"
BBFILES += "${LAYERDIR}/recipes-*/*/*.bb ${LAYERDIR}/recipes-*/*/*.bbappend"
BBFILE_COLLECTIONS += "orin-qdma"
BBFILE_PATTERN_orin-qdma = "^${LAYERDIR}/"
BBFILE_PRIORITY_orin-qdma = "10"
LAYERSERIES_COMPAT_orin-qdma = "wrynose"
LAYERDEPENDS_orin-qdma = "core tegra"
```
